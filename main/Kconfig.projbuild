## main/Kconfig.projbuild
```kconfig
menu "Project configuration"

    config MDNS_HOSTNAME
        string "mDNS hostname"
        default "esp32-fs"
        help
            Hostname that the device will respond to.

    config HTTPD_CONN_CLOSE_HEADER
        bool "Send connection close header from request handlers"
        default y
        help
            If this config item is set, Connection: close header will be set in handlers.
            This closes HTTP connection and frees the server socket instantly.
            
endmenu
```
